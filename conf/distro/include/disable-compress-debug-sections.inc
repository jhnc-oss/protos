## conf/distro/include/disable-compress-debug-sections.inc
```bitbake
# Disable compress-debug-sections allowing older binutils
# (e.g. version 2.29) to consume libraries packaged by
# yocto builds (binutils 2.34).
TARGET_CFLAGS += "-Wa,--compress-debug-sections=none"
```

## conf/distro/include/preferred-versions.inc
```bitbake
# glibc
PREFERRED_VERSION_cross-localedef-native ?= "2.27"
PREFERRED_VERSION_glibc ?= "2.27"
PREFERRED_VERSION_glibc-locale ?= "2.27"
PREFERRED_VERSION_glibc-mtrace ?= "2.27"
PREFERRED_VERSION_glibc-scripts ?= "2.27"
PREFERRED_VERSION_nativesdk-glibc ?= "2.27"
PREFERRED_VERSION_nativesdk-glibc-locale ?= "2.27"

# NOTE: Use the following template to append entries
# <PACKAGENAME>
# PREFERRED_VERSION_<PACKAGENAME> ?= "<VERSION>"
```

## conf/distro/protos.conf
```bitbake
include conf/distro/poky.conf
include conf/distro/include/disable-compress-debug-sections.inc
include conf/distro/include/preferred-versions.inc

DISTRO = "protos"
DISTRO_NAME = "protos (PROTOS Linux Distribution)"
DISTRO_MILESTONE="16"
DISTRO_CODENAME = "spice"
SDK_VENDOR = "-protossdk"
SDK_VERSION = "${DISTRO_VERSION}-${DISTRO_MILESTONE}"

TARGET_VENDOR = "-protos"
```

## conf/layer.conf
```bitbake
# We have a conf and classes directory, add to BBPATH
BBPATH .= ":${LAYERDIR}"

# We have recipes-* directories, add to BBFILES
BBFILES += "${LAYERDIR}/recipes-*/*/*.bb \
            ${LAYERDIR}/recipes-*/*/*.bbappend"

BBFILE_COLLECTIONS += "protos"
BBFILE_PATTERN_protos = "^${LAYERDIR}/"

# enforce precedence over any other layer
BBFILE_PRIORITY_protos = "10"

LAYERDEPENDS_protos = "core"
LAYERVERSION_protos = "1"
LAYERSERIES_COMPAT_protos = "dunfell kirkstone"
```

## meta-protos/conf/distro/protos.conf
```bitbake
include conf/distro/poky.conf

DISTRO = "protos"
DISTRO_NAME = "protos (PROTOS Linux Distribution)"
DISTRO_CODENAME = "shuloch"
SDK_VENDOR = "-protossdk"
SDK_VERSION = "${DISTRO_VERSION}"

TARGET_VENDOR = "-protos"

DISTRO_FEATURES:append = " polkit"
DISTRO_FEATURES:append = " security"
```

## meta-protos/meta-python/conf/layer.conf
```bitbake
# We have a conf and classes directory, add to BBPATH
BBPATH .= ":${LAYERDIR}"

# We have recipes-* directories, add to BBFILES
BBFILES += "${LAYERDIR}/recipes-*/*/*/*.bb \
            ${LAYERDIR}/recipes-*/*/*/*.bbappend \
            ${LAYERDIR}/recipes-*/*/*.bb \
            ${LAYERDIR}/recipes-*/*/*.bbappend \
"

BBFILE_COLLECTIONS += "meta-protos-meta-python"
BBFILE_PATTERN_meta-protos-meta-python = "^${LAYERDIR}/"

# enforce layer precedence
BBFILE_PRIORITY_meta-protos-meta-python = "8"

LAYERDEPENDS_meta-protos-meta-python = "core"
LAYERSERIES_COMPAT_meta-protos-meta-python = "kirkstone scarthgap whinlatter"
```
